## configs/sshfs-static-x86_64_defconfig
```kconfig
BR2_x86_64=y
BR2_WGET="wget -nd -t 3"
BR2_STATIC_LIBS=y
BR2_REPRODUCIBLE=y
BR2_PER_PACKAGE_DIRECTORIES=y
BR2_TOOLCHAIN_BUILDROOT_STATIC=y
BR2_TOOLCHAIN_BUILDROOT_MUSL=y
BR2_INIT_NONE=y
BR2_SYSTEM_BIN_SH_NONE=y
# BR2_PACKAGE_BUSYBOX is not set
BR2_PACKAGE_SSHFS=y
# BR2_PACKAGE_IFUPDOWN_SCRIPTS is not set
# BR2_PACKAGE_OPENSSH_SERVER is not set
# BR2_PACKAGE_OPENSSH_KEY_UTILS is not set
# BR2_TARGET_ROOTFS_TAR is not set
```
